#define CONFIG_WIRELESS

#include <dt-bindings/zmk/rgb.h>

#define RH2_BIND_Base  &kp BSPC
#define RH2_BIND_Nav   &kp LA(BSPC)
#define RH2_BIND_Fn    &trans
#define RH2_BIND_Num   &trans
#define RH2_BIND_Sys   &trans
#define RH2_BIND_Mouse &trans

#define SYS_APOS_BIND &rgb_ug RGB_TOG

#define RH2_BIND(name) RH2_BIND_##name

#define ZMK_BASE_LAYER(name, LT, RT, LM, RM, LB, RB, LH, RH)                 \
    ZMK_LAYER(                                                               \
        name,                                                                \
                 LT &none &none RT                                           \
                 LM &none &none RM                                           \
                 LB RB                                                       \
        &kp ESC LH RH RH2_BIND(name)                                       \
    )

#include "corne_choc_pro_key_labels.h"
#include "base.keymap"

/ { chosen { zmk,physical-layout = &five_col_layout; }; };
